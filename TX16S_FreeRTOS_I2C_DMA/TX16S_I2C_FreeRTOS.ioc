# file: TX16S_I2C_FreeRTOS.ioc
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PD12.GPIO_Label=HEARTBEAT
NVIC.I2C1_EV_IRQn=true\:5\:0\:false\:false\:true\:true\:true\:true
SH.FMC_A0.0=FMC_A0,12b-sda1
FATFS0.BSP.api=Unknown
PH15.GPIO_Label=SWJ
PG8.Signal=FMC_SDCLK
Dma.I2C1_TX.1.Mode=DMA_NORMAL
PG0.Signal=FMC_A10
PI15.GPIO_Label=SWAL
PK1.Signal=LTDC_G6
SH.FMC_D5_DA5.0=FMC_D5,sd-16b-d1
SH.FMC_D9_DA9.0=FMC_D9,sd-16b-d1
FREERTOS.configENABLE_FPU=1
PJ8.GPIO_PuPd=GPIO_PULLUP
PF7.Signal=ADC3_IN5
SH.FMC_SDNWE.0=FMC_SDNWE,12b-sda1
PD7.GPIO_PuPd=GPIO_PULLUP
PH9.Signal=GPIO_Input
SH.FMC_D11_DA11.0=FMC_D11,sd-16b-d1
PJ5.Mode=RGB565
RCC.APB2TimFreq_Value=168000000
PB6.Signal=USART1_TX
PC7.Signal=GPIO_Output
PD0.Signal=FMC_D2_DA2
PD8.Signal=FMC_D13_DA13
PE1.Signal=FMC_NBL1
FATFS0.BSP.ip=GPIO
PI4.GPIO_Label=KEYrtn
PB12.GPIO_Label=SWBL
PG14.Mode=Asynchronous
LTDC.PixelFormat_L0=LTDC_PIXEL_FORMAT_RGB565
LTDC.PixelFormat_L1=LTDC_PIXEL_FORMAT_RGB565
PC4.GPIO_Label=TrimLHR
PE9.Signal=FMC_D6_DA6
SH.FMC_A2.0=FMC_A2,12b-sda1
PB1.GPIO_Label=LCDbacklight
PE4.GPIO_Label=LEDgreen
PC9.Mode=SD_4_bits_Wide_bus
PA8.Signal=GPIO_Output
SH.FMC_D1_DA1.0=FMC_D1,sd-16b-d1
PH14.GPIO_PuPd=GPIO_PULLUP
LTDC.HSync=3
PH3.GPIO_PuPd=GPIO_PULLUP
PJ14.Signal=GPIO_Input
Mcu.Package=LQFP208
PB9.Signal=I2C1_SDA
PB1.Signal=GPIO_Output
PB14.GPIO_PuPd=GPIO_PULLUP
NVIC.TimeBase=TIM1_UP_TIM10_IRQn
SPI2.Mode=SPI_MODE_MASTER
PD12.Signal=GPIO_Input
ADC3.Rank-0\#ChannelRegularConversion=1
NVIC.TimeBaseIP=TIM1
PA10.Signal=GPIO_Input
PC11.Mode=SD_4_bits_Wide_bus
RCC.APB2CLKDivider=RCC_HCLK_DIV2
NVIC.EXTI2_IRQn=true\:5\:0\:false\:false\:true\:true\:true\:true
LTDC.VSync=11
RCC.APB1TimFreq_Value=84000000
PD3.GPIO_PuPd=GPIO_PULLUP
NVIC.DMA1_Stream6_IRQn=true\:5\:0\:false\:false\:true\:true\:false\:true
PA4.GPIO_Label=Audio
PD15.Signal=FMC_D1_DA1
PJ1.GPIO_Label=PWRon
PG12.Signal=GPIO_Input
PI5.GPIO_PuPd=GPIO_PULLUP
Dma.I2C1_RX.0.PeriphInc=DMA_PINC_DISABLE
FATFS0.BSP.STBoard=false
SH.FMC_A4.0=FMC_A4,12b-sda1
PK4.Signal=LTDC_B5
FREERTOS.Tasks01=defaultTask,24,512,StartDefaultTask,Default,NULL,Dynamic,NULL,NULL;TouchTask,24,512,TouchTaskEntry,Default,NULL,Dynamic,NULL,NULL
PG5.Signal=FMC_A15_BA1
PC13.Signal=GPIO_Input
SH.FMC_D10_DA10.0=FMC_D10,sd-16b-d1
FATFS0.BSP.mode=Input
PI6.GPIO_PuPd=GPIO_PULLUP
PD3.Signal=GPIO_Input
PG9.Mode=Asynchronous
PC2.Signal=ADCx_IN12
PI12.Signal=LTDC_HSYNC
PD6.Mode=Asynchronous
LTDC.ImageWidth_L1=480
PJ11.Signal=LTDC_G4
PF8.GPIO_Label=EX1
LTDC.ImageWidth_L0=480
PD10.Signal=FMC_D15_DA15
PJ6.Mode=RGB565
PJ8.GPIO_Label=TrimLSD
PJ3.Signal=LTDC_R4
PI8.GPIO_Label=KEYenter
PA8.GPIO_Label=IntModPwr
I2C1.I2C_Mode=I2C_Fast
PJ14.GPIO_PuPd=GPIO_PULLUP
PH11.GPIO_Label=ROTENCA
PB14.Signal=GPIO_Input
PA5.Signal=GPIO_Output
PC12.Mode=SD_4_bits_Wide_bus
PB13.GPIO_PuPd=GPIO_PULLUP
PI7.Signal=GPIO_Input
SH.FMC_A6.0=FMC_A6,12b-sda1
PE14.Signal=FMC_D11_DA11
PB4.GPIO_Label=TrainerDetect
PB15.GPIO_Label=SWCL
PG7.GPIO_Label=SWH
PI2.Signal=SPI2_MISO
PA1.GPIO_Label=StickLV
PF13.Signal=FMC_A7
PC7.GPIO_Label=TrainerOut
PC8.Mode=SD_4_bits_Wide_bus
PJ13.GPIO_PuPd=GPIO_PULLUP
PJ15.Mode=RGB565
PA5.GPIO_Label=TESTPOINT
PK4.Mode=RGB565
PE5.GPIO_Label=LEDblue
PJ0.GPIO_Label=PWRswitch
PJ8.Signal=GPIO_Input
ProjectManager.HeapSize=0x200
PH6.Signal=FMC_SDNE1
NVIC.PriorityGroup=NVIC_PRIORITYGROUP_4
PI11.GPIO_Label=KEYpageprevious
PE3.Signal=GPIO_Input
PJ4.Mode=RGB565
PC15/OSC32_OUT.Signal=RCC_OSC32_OUT
PF4.Signal=FMC_A4
PD2.Signal=SDIO_CMD
FATFS0.BSP.name=Detect_SDIO
Mcu.Family=STM32F4
PK3.Signal=LTDC_B4
SPI2.VirtualNSS=VM_NSSHARD
SH.FMC_A8.0=FMC_A8,12b-sda1
FREERTOS.BinarySemaphores01=BinSemI2CCB,Dynamic,NULL;BinSemTouchINT,Dynamic,NULL
PH14.Signal=GPIO_Input
PH10.Signal=GPIO_Input
SH.FMC_D14_DA14.0=FMC_D14,sd-16b-d1
PG2.Signal=GPIO_Input
PA11.Mode=Device_Only
PC14/OSC32_IN.Mode=LSE-External-Oscillator
SH.FMC_A14_BA0.0=FMC_BA0,FourSdramBanks1
SH.FMC_A11.0=FMC_A11,12b-sda1
PB13.GPIO_Label=TrimRSD
PB15.Signal=GPIO_Input
ADC3.Channel-0\#ChannelRegularConversion=ADC_CHANNEL_4
PG11.Signal=GPIO_Input
PG15.Signal=FMC_SDNCAS
PJ14.GPIO_Label=TrimLVU
PG3.GPIO_PuPd=GPIO_PULLUP
PD13.Signal=GPIO_Input
PA15.GPIO_Label=UART3Pwr
PJ2.Signal=LTDC_R3
PA7.PinState=GPIO_PIN_SET
SH.ADCx_IN3.0=ADC3_IN3,IN3
LTDC.WindowX1_L1=479
SH.FMC_NBL1.0=FMC_NBL1,Sd2ByteEnable1
LTDC.WindowX1_L0=479
Dma.I2C1_TX.1.PeriphInc=DMA_PINC_DISABLE
PK2.Mode=RGB565
PD5.Mode=Asynchronous
Dma.I2C1_RX.0.Priority=DMA_PRIORITY_LOW
RCC.HSE_VALUE=12000000
PI14.Mode=RGB565
PA6.GPIO_PuPd=GPIO_PULLUP
PF9.Mode=IN7
PH7.GPIO_Label=PCBREV1
PA14.Mode=Serial_Wire
PF11.Signal=FMC_SDNRAS
PJ7.GPIO_Label=SWDH
PI8.GPIO_PuPd=GPIO_PULLUP
PB5.Mode=SdramChipSelect2_1
PC13.GPIO_PuPd=GPIO_PULLUP
PJ12.GPIO_Label=TrimRV
PG7.GPIO_PuPd=GPIO_PULLUP
PB7.Signal=USART1_RX
PD13.GPIO_Label=TrimLSU
PA6.Signal=GPIO_Input
PB15.GPIO_PuPd=GPIO_PULLUP
USART6.VirtualMode=VM_ASYNC
PA15.Signal=GPIO_Output
PF8.Signal=ADC3_IN6
PI1.Mode=Full_Duplex_Master
SH.ADCx_IN1.0=ADC3_IN1,IN1
Dma.Request1=I2C1_TX
NVIC.DMA1_Stream0_IRQn=true\:5\:0\:false\:false\:true\:true\:false\:true
PG11.GPIO_Label=USBchaCtrl
PC5.Signal=GPIO_Input
PD3.GPIO_Label=TrimR
PE7.Signal=FMC_D4_DA4
PD6.Signal=USART2_RX
Dma.Request0=I2C1_RX
PE2.GPIO_Label=LEDred
PH15.GPIO_PuPd=GPIO_PULLUP
PB4.Signal=GPIO_Input
PG2.GPIO_Label=SWDL
PA3.Signal=ADCx_IN3
PK1.Mode=RGB565
PK6.Signal=LTDC_B7
SH.ADCx_IN13.0=ADC3_IN13,IN13
LTDC.WindowY1_L0=271
PG7.Signal=GPIO_Input
LTDC.WindowY1_L1=271
PH12.GPIO_Label=SWBH
PC11.Signal=SDIO_D3
PI14.Signal=LTDC_CLK
PC8.Signal=SDIO_D0
PC10.Mode=SD_4_bits_Wide_bus
PD9.Signal=FMC_D14_DA14
FATFS0.BSP.instance=PC5
PA13.Signal=SYS_JTMS-SWDIO
PA9.Mode=Activate_VBUS
ADC3.SamplingTime-0\#ChannelRegularConversion=ADC_SAMPLETIME_3CYCLES
PF6.Signal=ADC3_IN4
SH.FMC_D13_DA13.0=FMC_D13,sd-16b-d1
PH8.Signal=GPIO_Input
PB9.Mode=I2C
Dma.I2C1_TX.1.Instance=DMA1_Stream6
PF9.GPIO_Label=EX2
PA1.Signal=ADCx_IN1
PD2.Mode=SD_4_bits_Wide_bus
PK5.Mode=RGB565
board=custom
RCC.VCOOutputFreq_Value=336000000
PI9.Signal=GPIO_Output
PH4.GPIO_Label=SWEH
Dma.I2C1_TX.1.FIFOMode=DMA_FIFOMODE_DISABLE
SH.ADCx_IN11.0=ADC3_IN11,IN11
PI4.Signal=GPIO_Input
PC1.GPIO_Label=POS6
SH.FMC_D12_DA12.0=FMC_D12,sd-16b-d1
Dma.I2C1_TX.1.MemDataAlignment=DMA_MDATAALIGN_BYTE
PF1.Signal=FMC_A1
PJ0.Signal=GPIO_Input
PE0.Signal=FMC_NBL0
PE12.Signal=FMC_D9_DA9
RCC.48MHZClocksFreq_Value=48000000
RCC.SYSCLKFreq_VALUE=168000000
USART3.VirtualMode=VM_ASYNC
PJ5.Signal=LTDC_R6
Dma.I2C1_RX.0.FIFOMode=DMA_FIFOMODE_DISABLE
RCC.HSI_VALUE=16000000
RCC.PLLQ=7
PH3.Signal=GPIO_Input
RCC.PLLM=6
RCC.PLLN=168
PH12.GPIO_PuPd=GPIO_PULLUP
ADC3.NbrOfConversionFlag=1
LTDC.ImageHeight_L0=272
LTDC.ImageHeight_L1=272
Dma.I2C1_RX.0.Instance=DMA1_Stream0
PB12.Signal=GPIO_Input
PJ13.Signal=GPIO_Input
PA3.GPIO_Label=StickRV
SH.FMC_D7_DA7.0=FMC_D7,sd-16b-d1
PK5.Signal=LTDC_B6
PJ9.Mode=RGB565
PH12.Signal=GPIO_Input
PG2.GPIO_PuPd=GPIO_PULLUP
SPI2.VirtualType=VM_MASTER
PB10.Mode=Asynchronous
VP_FATFS_VS_SDIO.Mode=SDIO
PK0.Mode=RGB565
PG4.Signal=FMC_A14_BA0
PC12.Signal=SDIO_CK
PB14.GPIO_Label=TrimRSU
PG6.GPIO_Label=SWGH
PC6.GPIO_Label=TrainerIn
PA6.GPIO_Label=TrimLHL
PI6.GPIO_Label=KEYmdl
PB13.Signal=GPIO_Input
PG13.Signal=GPIO_Input
PE6.GPIO_Label=HAPTIC
PF6.GPIO_Label=SLIDER1
RCC.SYSCLKSource=RCC_SYSCLKSOURCE_PLLCLK
PJ10.Signal=LTDC_G3
SH.FMC_A15_BA1.0=FMC_BA1,FourSdramBanks1
PJ13.GPIO_Label=TrimRVD
PH5.Signal=FMC_SDNWE
USART3.BaudRate=400000
PD4.Signal=GPIO_Output
I2C1.DutyCycle=I2C_DUTYCYCLE_16_9
Dma.I2C1_RX.0.PeriphDataAlignment=DMA_PDATAALIGN_BYTE
PH1/OSC_OUT.Signal=RCC_OSC_OUT
PB6.Mode=Asynchronous
PC3.Signal=ADCx_IN13
PE5.Signal=GPIO_Output
PI3.Mode=Full_Duplex_Master
PF10.GPIO_Label=TOUCH_RST
PH10.GPIO_Label=ROTENCB
FATFS0.BSP.i2caddr=0
Dma.I2C1_RX.0.Mode=DMA_NORMAL
PG6.GPIO_PuPd=GPIO_PULLUP
PK7.Mode=RGB565
PJ2.Mode=RGB565
PI6.Signal=GPIO_Input
PI3.Signal=SPI2_MOSI
SPI2.CalculateBaudRate=21.0 MBits/s
PE2.Signal=GPIO_Output
PF8.Mode=IN6
Dma.I2C1_RX.0.Direction=DMA_PERIPH_TO_MEMORY
PF3.Signal=FMC_A3
PE10.Signal=FMC_D7_DA7
PI7.GPIO_PuPd=GPIO_PULLUP
FATFS0.BSP.solution=PC5
PJ4.Signal=LTDC_R5
PB8.GPIO_PuPdOD=GPIO_NOPULL
SH.FMC_A1.0=FMC_A1,12b-sda1
PH2.Signal=GPXTI2
SH.FMC_SDCLK.0=FMC_SDCLK,12b-sda1
PG12.GPIO_PuPd=GPIO_PULLUP
PF14.Signal=FMC_A8
PI11.Signal=GPIO_Input
SH.FMC_D3_DA3.0=FMC_D3,sd-16b-d1
PI10.GPIO_Label=LCDnRST
Dma.I2C1_TX.1.PeriphDataAlignment=DMA_PDATAALIGN_BYTE
PH15.Signal=GPIO_Input
PG9.Signal=USART6_RX
PC6.Signal=GPIO_Input
PD7.Signal=GPIO_Input
PD1.Signal=FMC_D3_DA3
PC0.Signal=ADCx_IN10
RCC.APB1CLKDivider=RCC_HCLK_DIV4
PG13.GPIO_Label=USBchgDetect
PI2.Mode=Full_Duplex_Master
PG10.Signal=GPIO_Output
SH.FMC_A3.0=FMC_A3,12b-sda1
PJ7.Signal=GPIO_Input
PB11.Mode=Asynchronous
SH.FMC_D15_DA15.0=FMC_D15,sd-16b-d1
PA9.Signal=USB_OTG_FS_VBUS
Dma.I2C1_RX.0.MemInc=DMA_MINC_ENABLE
PB10.Signal=USART3_TX
FATFS.BSP.number=1
PH9.GPIO_Label=SWAH
PJ15.Signal=LTDC_B3
PI9.GPIO_Label=INTMODboot
PH6.Mode=SdramChipSelect2_1
Dma.I2C1_TX.1.Priority=DMA_PRIORITY_LOW
PE15.Signal=FMC_D12_DA12
PE8.Signal=FMC_D5_DA5
PI1.Signal=SPI2_SCK
Dma.I2C1_TX.1.MemInc=DMA_MINC_ENABLE
PA0/WKUP.GPIO_Label=StickLH
PA13.Mode=Serial_Wire
SH.FMC_SDNCAS.0=FMC_SDNCAS,12b-sda1
PH14.GPIO_Label=SWI
PA4.Signal=COMP_DAC1_group
PB5.Signal=FMC_SDCKE1
PD11.Signal=GPIO_Input
USART1.VirtualMode=VM_ASYNC
LTDC.Alpha_L1=255
SH.FMC_A5.0=FMC_A5,12b-sda1
LTDC.Alpha_L0=255
PA11.Signal=USB_OTG_FS_DM
PF6.Mode=IN4
NVIC.TIM1_UP_TIM10_IRQn=true\:0\:0\:false\:false\:true\:false\:false\:true
PF9.Signal=ADC3_IN7
PJ10.Mode=RGB565
PB8.Mode=I2C
PC3.GPIO_Label=SLIDER2
PI4.GPIO_PuPd=GPIO_PULLUP
PJ12.GPIO_PuPd=GPIO_PULLUP
PG3.GPIO_Label=SWGL
PB0.Signal=GPIO_Output
PC1.Signal=ADCx_IN11
PH2.GPIO_Label=TOUCH_INT
PJ7.GPIO_PuPd=GPIO_PULLUP
PG10.GPIO_Label=BluetoothEn
PI12.Mode=RGB565
PK7.Signal=LTDC_DE
RCC.CortexFreq_Value=168000000
PG6.Signal=GPIO_Input
LTDC.HBP=40
SH.ADCx_IN2.0=ADC3_IN2,IN2
PC10.Signal=SDIO_D2
SH.FMC_NBL0.0=FMC_NBL0,Sd2ByteEnable1
PC0.GPIO_Label=POT1
SH.FMC_D6_DA6.0=FMC_D6,sd-16b-d1
PA0/WKUP.Signal=ADCx_IN0
PB0.GPIO_Label=UART6pwr
PI5.GPIO_Label=KEYtelem
PC13.GPIO_Label=KEYpagenext
PB11.Signal=USART3_RX
ProjectManager.StackSize=0x400
PI11.GPIO_PuPd=GPIO_PULLUP
VP_FREERTOS_VS_CMSIS_V2.Mode=CMSIS_V2
Dma.I2C1_TX.1.Direction=DMA_MEMORY_TO_PERIPH
PJ6.Signal=LTDC_R7
PD11.GPIO_PuPd=GPIO_PULLUP
SH.FMC_A7.0=FMC_A7,12b-sda1
PA12.Signal=USB_OTG_FS_DP
PH0/OSC_IN.Mode=HSE-External-Oscillator
PD11.GPIO_Label=SWCH
RCC.HCLKFreq_Value=168000000
PF12.Signal=FMC_A6
PI13.Signal=LTDC_VSYNC
SH.FMC_A10.0=FMC_A10,12b-sda1
RCC.AHBFreq_Value=168000000
SH.FMC_D8_DA8.0=FMC_D8,sd-16b-d1
PI8.Signal=GPIO_Input
SH.FMC_D2_DA2.0=FMC_D2,sd-16b-d1
PH4.GPIO_PuPd=GPIO_PULLUP
PE13.Signal=FMC_D10_DA10
PF7.GPIO_Label=VBattery
PI5.Signal=GPIO_Input
PK6.Mode=RGB565
VP_SYS_VS_tim1.Mode=TIM1
PI0.Signal=SPI2_NSS
PA10.GPIO_Label=ExtModTX
LTDC.HFP=3
SH.ADCx_IN0.0=ADC3_IN0,IN0
SH.FMC_SDNRAS.0=FMC_SDNRAS,12b-sda1
LTDC.ActiveW=480
PH1/OSC_OUT.Mode=HSE-External-Oscillator
PE4.Signal=GPIO_Output
FREERTOS.configTOTAL_HEAP_SIZE=32768
PD7.GPIO_Label=TrimRHR
SH.FMC_D0_DA0.0=FMC_D0,sd-16b-d1
PJ9.Signal=LTDC_G2
PJ12.Signal=GPIO_Input
USART2.VirtualMode=VM_ASYNC
PC14/OSC32_IN.Signal=RCC_OSC32_IN
PI10.PinState=GPIO_PIN_SET
PH9.GPIO_PuPd=GPIO_PULLUP
PA2.GPIO_Label=StickRH
USB_OTG_FS.VirtualMode=Device_Only
SH.FMC_A9.0=FMC_A9,12b-sda1
PJ1.Signal=GPIO_Output
SH.FMC_D4_DA4.0=FMC_D4,sd-16b-d1
RCC.PLLSAIN=50
PF5.Signal=FMC_A5
PH3.GPIO_Label=SWF
PH7.Signal=GPIO_Input
SPI2.Direction=SPI_DIRECTION_2LINES
PF0.Signal=FMC_A0
PC2.GPIO_Label=POT2
PB3.GPIO_Label=ExtModPwr
SH.COMP_DAC1_group.0=DAC_OUT1,DAC_OUT1
PK2.Signal=LTDC_G7
LTDC.FBStartAdress_L0=261120
LTDC.FBStartAdress_L1=261120
Dma.I2C1_RX.0.MemDataAlignment=DMA_MDATAALIGN_BYTE
PH11.Signal=GPIO_Input
PG3.Signal=GPIO_Input
PC4.GPIO_PuPd=GPIO_PULLUP
PG1.Signal=FMC_A11
PC4.Signal=GPIO_Input
PI10.Signal=GPIO_Output
PD5.Signal=USART2_TX
PJ11.Mode=RGB565
PF7.Mode=IN5
PH8.GPIO_Label=PCBREV2
SH.ADCx_IN12.0=ADC3_IN12,IN12
PH4.Signal=GPIO_Input
ProjectManager.TargetToolchain=STM32CubeIDE
LTDC.ActiveH=272
PI0.Mode=NSS_Signal_Hard_Output
PF2.Signal=FMC_A2
PE11.Signal=FMC_D8_DA8
PK0.Signal=LTDC_G5
PG14.Signal=USART6_TX
PJ3.Mode=RGB565
PH0/OSC_IN.Signal=RCC_OSC_IN
RCC.APB2Freq_Value=84000000
PD4.GPIO_Label=TelemDir
PF10.Signal=GPIO_Output
PI7.GPIO_Label=KEYsys
PD13.GPIO_PuPd=GPIO_PULLUP
PF15.Signal=FMC_A9
PE6.Signal=GPIO_Output
PI13.Mode=RGB565
Mcu.Name=STM32F429B(E-G-I)Tx
PA2.Signal=ADCx_IN2
PD14.Signal=FMC_D0_DA0
PB3.Signal=GPIO_Output
PA7.GPIO_Label=AudioMute
PA12.Mode=Device_Only
PC5.GPIO_Label=SDpresent
PC15/OSC32_OUT.Mode=LSE-External-Oscillator
PB7.Mode=Asynchronous
PA14.Signal=SYS_JTCK-SWCLK
SH.ADCx_IN10.0=ADC3_IN10,IN10
PG12.GPIO_Label=TrimLVD
PB9.GPIO_PuPdOD=GPIO_NOPULL
PK3.Mode=RGB565
PI15.Signal=GPIO_Input
PB8.Signal=I2C1_SCL
PE3.GPIO_Label=SWEL
PC9.Signal=SDIO_D1
RCC.APB1Freq_Value=42000000
PJ1.PinState=GPIO_PIN_SET
PA7.Signal=GPIO_Output
PI15.GPIO_PuPd=GPIO_PULLUP

// file: Core/Src/main.c
/* USER CODE BEGIN Header */
/**
  ******************************************************************************
  * @file           : main.c
  * @brief          : Main program body
  ******************************************************************************
  * @attention
  *
  * <h2><center>&copy; Copyright (c) 2021 STMicroelectronics.
  * All rights reserved.</center></h2>
  *
  * This software component is licensed by ST under BSD 3-Clause license,
  * the "License"; You may not use this file except in compliance with the
  * License. You may obtain a copy of the License at:
  *                        opensource.org/licenses/BSD-3-Clause
  *
  ******************************************************************************
  */
/* USER CODE END Header */
#include "main.h"
#include "cmsis_os.h"
#include "fatfs.h"

/* USER CODE BEGIN Includes */
#include "semphr.h"
/* USER CODE END Includes */

/* USER CODE BEGIN PTD */
typedef struct {
	uint8_t track ;
	uint16_t x ;
	uint16_t y ;
	uint16_t size ;
	uint8_t reserved ;
} TouchPoint;
/* USER CODE END PTD */

/* USER CODE BEGIN PD */
#define GT911_I2C_ADDR                  0x14
#define GT911_MAX_TP                    5
#define GT911_CFG_NUMER                 0x6D
#define GT911_TIMEOUT                   3 // 3ms

#define GT_CTRL_REG                     0x8040
#define GT_CFGS_REG                     0x8047
#define GT_CHECK_REG                    0x80FF
#define GT_PID_REG                      0x8140

#define GT_GSTID_REG                    0x814E
#define GT_TP1_REG                      0x8150
#define GT_TP2_REG                      0x8158
#define GT_TP3_REG                      0x8160
#define GT_TP4_REG                      0x8168
#define GT_TP5_REG                      0x8170

#define GT911_READ_XY_REG               0x814E
#define GT911_CLEARBUF_REG              0x814E
#define GT911_CONFIG_REG                0x8047
#define GT911_COMMAND_REG               0x8040
#define GT911_PRODUCT_ID_REG            0x8140
#define GT911_VENDOR_ID_REG             0x814A
#define GT911_CONFIG_VERSION_REG        0x8047
#define GT911_CONFIG_CHECKSUM_REG       0x80FF
#define GT911_FIRMWARE_VERSION_REG      0x8144

#define TPRST_LOW()   HAL_GPIO_WritePin(TOUCH_RST_GPIO_Port, TOUCH_RST_Pin, GPIO_PIN_RESET)
#define TPRST_HIGH()  HAL_GPIO_WritePin(TOUCH_RST_GPIO_Port, TOUCH_RST_Pin, GPIO_PIN_SET)

#define TPINT_LOW()   HAL_GPIO_WritePin(TOUCH_INT_GPIO_Port, TOUCH_INT_Pin, GPIO_PIN_RESET)
#define TPINT_HIGH()  HAL_GPIO_WritePin(TOUCH_INT_GPIO_Port, TOUCH_INT_Pin, GPIO_PIN_SET)

#define I2C_TIMEOUT pdMS_TO_TICKS(20)

//GT911 param table
const uint8_t TOUCH_GT911_Cfg[] =
{
	GT911_CFG_NUMER,// 0x8047 Config version
	0xE0,			// 0x8048 X output map : x 480
	0x01,
	0x10,			// 0x804A Y ouptut max : y 272
	0x01,
	GT911_MAX_TP,	// 0x804C Touch number
	0x3C,			// 0x804D Module switch 1 : bit4= xy change Int mode
	0x20,			// 0x804E Module switch 2
	0x22,			// 0x804F Shake_Count
	0x0A,			// 0x8050 Filter
	0x28,			// 0x8051 Larger touch
	0x0F,			// 0x8052 Noise reduction
	0x5A,			// 0x8053 Screen touch level
	0x3C,			// 0x8054 Screen touch leave
	0x03,			// 0x8055 Low power control
	0x0F,			// 0x8056 Refresh rate
	0x01,			// 0x8057 X threshold
	0x01,			// 0x8058 Y threshold
	0x00,			// 0x8059 Reserved
	0x00,			// 0x805A Reserved
	0x11,			// 0x805B Space (top, bottom)
	0x11,			// 0x805C Space (left, right)
	0x08,			// 0x805D Mini filter
	0x18,			// 0x805E Strech R0
	0x1A,			// 0x805F Strech R1
	0x1E,			// 0x8060 Strech R2
	0x14,			// 0x8061 Strech RM
	0x87,			// 0x8062 Drv groupA num
	0x29,			// 0x8063 Drv groupB num
	0x0A,			// 0x8064 Sensor num
	0xCF,			// 0x8065 FreqA factor
	0xD1,			// 0x8066 FreqB factor
	0xB2,			// 0x8067 Panel bit freq
	0x04,
	0x00,			// 0x8069 Reserved
	0x00,
	0x00,			// 0x806B Panel tx gain
	0xD8,			// 0x806C Panel rx gain
	0x02,			// 0x806D Panel dump shift
	0x1D,			// 0x806E Drv frame control
	0x00,			// 0x806F Charging level up
	0x01,			// 0x8070 Module switch 3
	0x00,			// 0x8071 Gesture distance
	0x00,			// 0x8072 Gesture long press time
	0x00,			// 0x8073 X/Y slope adjust
	0x00,			// 0x8074 Gesture control
	0x00,			// 0x8075 Gesture switch 1
	0x00,			// 0x8076 Gesture switch 2
	0x00,			// 0x8077 Gesture refresh rate
	0x00,			// 0x8078 Gesture touch level
	0x00,			// 0x8079 New green wake up level
	0xB4,			// 0x807A Freq hopping start
	0xEF,			// 0x807B Freq hopping end
	0x94,			// 0x807C Noise detect time
	0xD5,			// 0x807D Hopping flag
	0x02,			// 0x807E Hopping flag
	0x07,			// 0x807F Noise threshold
	0x00,			// 0x8080 Nois min threshold old
	0x00,			// 0x8081 Reserved
	0x04,			// 0x8082 Hopping sensor group
	0x6E,			// 0x8083 Hopping Seg1 normalize
	0xB9,			// 0x8084 Hopping Seg1 factor
	0x00,			// 0x8085 Main clock adjust
	0x6A,			// 0x8086 Hopping Seg2 normalize
	0xC4,			// 0x8087 Hopping Seg2 factor
	0x00,			// 0x8088 Reserved
	0x66,			// 0x8089 Hopping Seg3 normalize
	0xCF,			// 0x808A Hopping Seg3 factor
	0x00,			// 0x808B Reserved
	0x62,			// 0x808C Hopping Seg4 normalize
	0xDB,			// 0x808D Hopping Seg4 factor
	0x00,			// 0x808E Reserved
	0x5E,			// 0x808F Hopping Seg5 normalize
	0xE8,			// 0x8090 Hopping Seg5 factor
	0x00,			// 0x8091 Reserved
	0x5E,			// 0x8092 Hopping Seg6 normalize
	0x00,			// 0x8093 Key1
	0x00,			// 0x8094 Key2
	0x00,			// 0x8095 Key3
	0x00,			// 0x8096 Key4
	0x00,			// 0x8097 Key area
	0x00,			// 0x8098 Key touch level
	0x00,			// 0x8099 Key leave level
	0x00,			// 0x809A Key sens
	0x00,			// 0x809B Key sens
	0x00,			// 0x809C Key restrain
	0x00,			// 0x809D Key restrain time
	0x00,			// 0x809E Large gesture touch
	0x00,			// 0x809F Reserved
	0x00,			// 0x80A0 Reserved
	0x00,			// 0x80A1 Hotknot noise map
	0x00,			// 0x80A2 Link threshold
	0x00,			// 0x80A3 Pxy threshold
	0x00,			// 0x80A4 GHot dump shift
	0x00,			// 0x80A5 GHot rx gain
	0x00,			// 0x80A6 Freg gain
	0x00,			// 0x80A7 Freg gain 1
	0x00,			// 0x80A8 Freg gain 2
	0x00,			// 0x80A9 Freg gain 3
	0x00,			// 0x80AA Reserved
	0x00,			// 0x80AB Reserved
	0x00,			// 0x80AC Reserved
	0x00,			// 0x80AD Reserved
	0x00,			// 0x80AE Reserved
	0x00,			// 0x80AF Reserved
	0x00,			// 0x80B0 Reserved
	0x00,			// 0x80B1 Reserved
	0x00,			// 0x80B2 Reserved
	0x00,			// 0x80B3 Combine dis
	0x00,			// 0x80B4 Split set
	0x00,			// 0x80B5 Reserved
	0x00,			// 0x80B6 Reserved
	0x14,			// 0x80B7 Sensor CH0
	0x12,			// 0x80B8 Sensor CH1
	0x10,			// 0x80B9 Sensor CH2
	0x0E,			// 0x80BA Sensor CH3
	0x0C,			// 0x80BB Sensor CH4
	0x0A,			// 0x80BC Sensor CH5
	0x08,			// 0x80BD Sensor CH6
	0x06,			// 0x80BE Sensor CH7
	0x04,			// 0x80BF Sensor CH8
	0x02,			// 0x80C0 Sensor CH9
	0xFF,			// 0x80C1 Sensor CH10
	0xFF,			// 0x80C2 Sensor CH11
	0xFF,			// 0x80C3 Sensor CH12
	0xFF,			// 0x80C4 Sensor CH13
	0x00,			// 0x80C5 Reserved
	0x00,			// 0x80C6 Reserved
	0x00,			// 0x80C7 Reserved
	0x00,			// 0x80C8 Reserved
	0x00,			// 0x80C9 Reserved
	0x00,			// 0x80CA Reserved
	0x00,			// 0x80CB Reserved
	0x00,			// 0x80CC Reserved
	0x00,			// 0x80CD Reserved
	0x00,			// 0x80CE Reserved
	0x00,			// 0x80CF Reserved
	0x00,			// 0x80D0 Reserved
	0x00,			// 0x80D1 Reserved
	0x00,			// 0x80D2 Reserved
	0x00,			// 0x80D3 Reserved
	0x00,			// 0x80D4 Reserved
	0x28,			// 0x80D5 Driver CH0
	0x26,			// 0x80D6 Driver CH1
	0x24,			// 0x80D7 Driver CH2
	0x22,			// 0x80D8 Driver CH3
	0x21,			// 0x80D9 Driver CH4
	0x20,			// 0x80DA Driver CH5
	0x1F,			// 0x80DB Driver CH6
	0x1E,			// 0x80DC Driver CH7
	0x1D,			// 0x80DD Driver CH8
	0x0C,			// 0x80DE Driver CH9
	0x0A,			// 0x80DF Driver CH10
	0x08,			// 0x80E0 Driver CH11
	0x06,			// 0x80E1 Driver CH12
	0x04,			// 0x80E2 Driver CH13
	0x02,			// 0x80E3 Driver CH14
	0x00,			// 0x80E4 Driver CH15
	0xFF,			// 0x80E5 Driver CH16
	0xFF,			// 0x80E6 Driver CH17
	0xFF,			// 0x80E7 Driver CH18
	0xFF,			// 0x80E8 Driver CH19
	0xFF,			// 0x80E9 Driver CH20
	0xFF,			// 0x80EA Driver CH21
	0xFF,			// 0x80EB Driver CH22
	0xFF,			// 0x80EC Driver CH23
	0xFF,			// 0x80ED Driver CH24
	0xFF,			// 0x80EE Driver CH25
	0x00,			// 0x80EF Reserved
	0x00,			// 0x80F0 Reserved
	0x00,			// 0x80F1 Reserved
	0x00,			// 0x80F2 Reserved
	0x00,			// 0x80F3 Reserved
	0x00,			// 0x80F4 Reserved
	0x00,			// 0x80F5 Reserved
	0x00,			// 0x80F6 Reserved
	0x00,			// 0x80F7 Reserved
	0x00,			// 0x80F8 Reserved
	0x00,			// 0x80F9 Reserved
	0x00,			// 0x80FA Reserved
	0x00,			// 0x80FB Reserved
	0x00,			// 0x80FC Reserved
	0x00,			// 0x80FD Reserved
	0x00			// 0x80FE Reserved
};
/* USER CODE END PD */

/* USER CODE BEGIN PM */
struct TouchData {
	union
	{
		TouchPoint points[GT911_MAX_TP] ;
		uint8_t data[GT911_MAX_TP * sizeof(TouchPoint)] ;
	};
};

enum TouchEvent
{
	TE_NONE,
	TE_DOWN,
	TE_UP,
	TE_SLIDE,
	TE_SLIDE_END
};

struct TouchState
{
	unsigned char event;
	short x;
	short y;
	short startX;
	short startY;
	short deltaX;
	short deltaY;
	short lastDeltaX;
	short lastDeltaY;
};
/* USER CODE END PM */

ADC_HandleTypeDef hadc3;

DAC_HandleTypeDef hdac;

I2C_HandleTypeDef hi2c1;
DMA_HandleTypeDef hdma_i2c1_rx;
DMA_HandleTypeDef hdma_i2c1_tx;

LTDC_HandleTypeDef hltdc;

SD_HandleTypeDef hsd;

SPI_HandleTypeDef hspi2;

UART_HandleTypeDef huart1;
UART_HandleTypeDef huart2;
UART_HandleTypeDef huart3;
UART_HandleTypeDef huart6;

PCD_HandleTypeDef hpcd_USB_OTG_FS;

SDRAM_HandleTypeDef hsdram1;

/* Definitions for defaultTask */
osThreadId_t defaultTaskHandle;
const osThreadAttr_t defaultTask_attributes = {
  .name = "defaultTask",
  .stack_size = 512 * 4,
  .priority = (osPriority_t) osPriorityNormal,
};
/* Definitions for TouchTask */
osThreadId_t TouchTaskHandle;
const osThreadAttr_t TouchTask_attributes = {
  .name = "TouchTask",
  .stack_size = 512 * 4,
  .priority = (osPriority_t) osPriorityNormal,
};
/* Definitions for BinSemI2CCB */
osSemaphoreId_t BinSemI2CCBHandle;
const osSemaphoreAttr_t BinSemI2CCB_attributes = {
  .name = "BinSemI2CCB"
};
/* Definitions for BinSemTouchINT */
osSemaphoreId_t BinSemTouchINTHandle;
const osSemaphoreAttr_t BinSemTouchINT_attributes = {
  .name = "BinSemTouchINT"
};
/* USER CODE BEGIN PV */
uint16_t touchGT911fwver = 0;
uint16_t touchGT911hiccups = 0;
struct TouchData touchData;
struct TouchState touchState;
const uint8_t SLIDE_RANGE = 6;
/* USER CODE END PV */

void SystemClock_Config(void);
static void MX_GPIO_Init(void);
static void MX_DMA_Init(void);
static void MX_USB_OTG_FS_PCD_Init(void);
static void MX_FMC_Init(void);
static void MX_USART3_UART_Init(void);
static void MX_LTDC_Init(void);
static void MX_I2C1_Init(void);
static void MX_ADC3_Init(void);
static void MX_DAC_Init(void);
static void MX_SDIO_SD_Init(void);
static void MX_SPI2_Init(void);
static void MX_USART1_UART_Init(void);
static void MX_USART2_UART_Init(void);
static void MX_USART6_UART_Init(void);
void StartDefaultTask(void *argument);
void TouchTaskEntry(void *argument);

/* USER CODE BEGIN 0 */
#define TRACE_TIME_FORMAT     "%0.2f "
#define TRACE_TIME_VALUE      ((float)HAL_GetTick())
#define CRLF "\r\n"

#define PRINTF_BUFFER_SIZE    128

void serialPrintf(const char * format, ...)
{
	va_list arglist;
	char tmp[PRINTF_BUFFER_SIZE + 1];

	snprintf(tmp, PRINTF_BUFFER_SIZE, "+%05lums: ", HAL_GetTick());
	va_start(arglist, format);
	vsnprintf(tmp + strlen(tmp), PRINTF_BUFFER_SIZE - strlen(tmp), format, arglist);
	tmp[PRINTF_BUFFER_SIZE] = '\0';
	va_end(arglist);

	const char *t = tmp;
	HAL_UART_Transmit(&huart3, (uint8_t *) t, strlen(t), 10);
}

#define debugPrintf(...) do { serialPrintf(__VA_ARGS__); } while(0)
#define TRACE(f_, ...)        debugPrintf((TRACE_TIME_FORMAT f_ CRLF), TRACE_TIME_VALUE, ##__VA_ARGS__)

void TOUCH_AF_INT_Change(void)
{
	GPIO_InitTypeDef GPIO_InitStructure;

	GPIO_InitStructure.Pin = TOUCH_INT_Pin;
	GPIO_InitStructure.Speed = GPIO_SPEED_HIGH;
	GPIO_InitStructure.Pull = GPIO_PULLUP;
	GPIO_InitStructure.Mode = GPIO_MODE_INPUT;
	HAL_GPIO_Init(TOUCH_INT_GPIO_Port, &GPIO_InitStructure);
}

static void TOUCH_AF_GPIOConfig(void)
{
	GPIO_InitTypeDef GPIO_InitStructure;
	GPIO_InitStructure.Pin = TOUCH_RST_Pin;
	GPIO_InitStructure.Mode = GPIO_MODE_OUTPUT_PP;
	GPIO_InitStructure.Speed = GPIO_SPEED_HIGH;
	GPIO_InitStructure.Pull = GPIO_NOPULL;
	HAL_GPIO_Init(TOUCH_RST_GPIO_Port, &GPIO_InitStructure);

	HAL_GPIO_WritePin(TOUCH_RST_GPIO_Port, TOUCH_RST_Pin, GPIO_PIN_RESET);

	GPIO_InitStructure.Pin = TOUCH_INT_Pin;
	GPIO_InitStructure.Mode = GPIO_MODE_OUTPUT_PP;
	GPIO_InitStructure.Speed = GPIO_SPEED_HIGH;
	GPIO_InitStructure.Pull = GPIO_NOPULL;
	HAL_GPIO_Init(TOUCH_INT_GPIO_Port, &GPIO_InitStructure);

	HAL_GPIO_WritePin(TOUCH_INT_GPIO_Port, TOUCH_INT_Pin, GPIO_PIN_RESET);
}

bool I2C_GT911_ReadRegister(uint16_t reg, uint8_t * buf, uint8_t len)
{
	if (HAL_I2C_Mem_Read_DMA(&hi2c1, GT911_I2C_ADDR << 1, reg, I2C_MEMADD_SIZE_16BIT, buf, len) != HAL_OK)
	{
		TRACE("I2C ERROR: GT911 ReadRegister failed");
		asm("bkpt 255");
		return false;
	}
	if (xSemaphoreTake(BinSemI2CCBHandle, I2C_TIMEOUT) != pdPASS) // Wait for semaphore from HAL_I2C_MemRxCpltCallback()
	{
		TRACE("I2C ERROR: GT911 WriteRegister did not succeed");
		asm("bkpt 255");
		return false;
	}
	return true;
}

bool I2C_GT911_WriteRegister(uint16_t reg, uint8_t * buf, uint8_t len)
{
	if (HAL_I2C_Mem_Write_DMA(&hi2c1, GT911_I2C_ADDR << 1, reg, I2C_MEMADD_SIZE_16BIT, buf, len) != HAL_OK)
	{
		TRACE("I2C ERROR: GT911 WriteRegister failed");
		asm("bkpt 255");
		return false;
	}
	if (xSemaphoreTake(BinSemI2CCBHandle, I2C_TIMEOUT) != pdPASS) // Wait for semaphore from HAL_I2C_MemTxCpltCallback()
	{
		TRACE("I2C ERROR: GT911 WriteRegister did not succeed");
		asm("bkpt 255");
		return false;
	}
	return true;
}

bool I2C_GT911_SendConfig(void)
{
	uint8_t buf[2];
	uint8_t i = 0;
	buf[0] = 0;
	buf[1] = 1;
	bool bResult = true;

	for (i = 0; i < sizeof(TOUCH_GT911_Cfg); i++)
		buf[0] += TOUCH_GT911_Cfg[i];//check sum

	buf[0] = (~buf[0]) + 1;
	if (!I2C_GT911_WriteRegister(GT_CFGS_REG, (uint8_t *) TOUCH_GT911_Cfg, sizeof(TOUCH_GT911_Cfg)))
	{
		TRACE("GT911 ERROR: write config failed");
		bResult = false;
	}

	if (!I2C_GT911_WriteRegister(GT_CHECK_REG, buf, 2)) //write checksum
		{
			TRACE("GT911 ERROR: write config checksum failed");
			bResult = false;
		}
	return bResult;
}

bool touchPanelInit(void)
{
	uint8_t tmp[4] = { 0 };

	TRACE("Touchpanel init start ...");

	TOUCH_AF_GPIOConfig(); //SET RST=OUT INT=OUT INT=LOW
	//I2C_Init();

	TPRST_LOW();
	TPINT_HIGH();
	osDelay(pdMS_TO_TICKS(1));

	TPRST_HIGH();
	osDelay(pdMS_TO_TICKS(6));

	TPINT_LOW();
	osDelay(pdMS_TO_TICKS(55));

	TOUCH_AF_INT_Change();  //Set INT INPUT INT=LOW

	osDelay(pdMS_TO_TICKS(50));

	TRACE("Reading Touch registry");
	if (!I2C_GT911_ReadRegister(GT_PID_REG, tmp, 4))
	{
		TRACE("GT911 ERROR: Product ID read failed");
	}

	if (strcmp((char *) tmp, "911") == 0)
	{
		TRACE("GT911 chip detected");
		tmp[0] = 0x02;
		if (!I2C_GT911_WriteRegister(GT_CTRL_REG, tmp, 1))
		{
			TRACE("GT911 ERROR: write to control register failed");
		}
		if (!I2C_GT911_ReadRegister(GT_CFGS_REG, tmp, 1))
		{
			TRACE("GT911 ERROR: configuration register read failed");
		}

		TRACE("Chip config Ver:%x", tmp[0]);
		if (tmp[0] <= GT911_CFG_NUMER)  //Config ver
		{
			TRACE("Sending new config %d", GT911_CFG_NUMER);
			if (!I2C_GT911_SendConfig())
			{
				TRACE("GT911 ERROR: sending configration failed");
			}
		}

		if (!I2C_GT911_ReadRegister(GT911_FIRMWARE_VERSION_REG, tmp, 2))
		{
			TRACE("GT911 ERROR: reading firmware version failed");
		}
		else
		{
			touchGT911fwver = (tmp[1] << 8) + tmp[0];
			TRACE("GT911 FW version: %u", touchGT911fwver);
		}

		osDelay(pdMS_TO_TICKS(10));

		tmp[0] = 0X00;
		if (!I2C_GT911_WriteRegister(GT_CTRL_REG, tmp, 1))  //end reset
		{
			TRACE("GT911 ERROR: write to control register failed");
		}
		// touchGT911Flag = true;

		//TOUCH_AF_ExtiConfig();

		return true;
	}
	TRACE("GT911 chip NOT FOUND");
	return false;
}

void touchPanelDeInit(void)
{
	//TOUCH_AF_ExtiStop();
	//touchGT911Flag = false;
	TRACE("touchPanelDeInit()");
	asm("bkpt 255");
}

void touchPanelRead()
{
	uint8_t state = 0;

	// if (!touchEventOccured)
	//   return;

	// touchEventOccured = false;

	uint32_t startReadStatus = HAL_GetTick();
	do {
		if (!I2C_GT911_ReadRegister(GT911_READ_XY_REG, &state, 1)) {
			HAL_GPIO_WritePin(LEDred_GPIO_Port, LEDred_Pin, GPIO_PIN_SET);
			HAL_GPIO_WritePin(LEDgreen_GPIO_Port, LEDgreen_Pin, GPIO_PIN_RESET);
			HAL_GPIO_WritePin(LEDblue_GPIO_Port, LEDblue_Pin, GPIO_PIN_RESET);
			touchGT911hiccups++;
			TRACE("GT911 I2C read XY error");
			touchPanelDeInit();
			touchPanelInit();
			return;
		}

		if (state & 0x80u) {
			// ready
			break;
		}
		osDelay(pdMS_TO_TICKS(1));
	} while (HAL_GetTick() - startReadStatus < GT911_TIMEOUT);

	TRACE("touch state = 0x%x", state);
	if (state & 0x80u) {
		uint8_t pointsCount = (state & 0x0Fu);

		if (pointsCount > 0 && pointsCount <= GT911_MAX_TP) {
			if (!I2C_GT911_ReadRegister(GT911_READ_XY_REG + 1, touchData.data, pointsCount * sizeof(TouchPoint)))
			{
				HAL_GPIO_WritePin(LEDred_GPIO_Port, LEDred_Pin, GPIO_PIN_SET);
				HAL_GPIO_WritePin(LEDgreen_GPIO_Port, LEDgreen_Pin, GPIO_PIN_RESET);
				HAL_GPIO_WritePin(LEDblue_GPIO_Port, LEDblue_Pin, GPIO_PIN_RESET);
				touchGT911hiccups++;
				TRACE("GT911 I2C data read error");
				touchPanelDeInit();
				touchPanelInit();
				return;
			}
			if (touchState.event == TE_NONE || touchState.event == TE_UP || touchState.event == TE_SLIDE_END)
			{
				touchState.event = TE_DOWN;
				touchState.startX = touchState.x = touchData.points[0].x;
				touchState.startY = touchState.y = touchData.points[0].y;
			}
			else
			{
				touchState.deltaX = touchData.points[0].x - touchState.x;
				touchState.deltaY = touchData.points[0].y - touchState.y;
				if (touchState.event == TE_SLIDE || abs(touchState.deltaX) >= SLIDE_RANGE || abs(touchState.deltaY) >= SLIDE_RANGE)
				{
					touchState.event = TE_SLIDE;
					touchState.x = touchData.points[0].x;
					touchState.y = touchData.points[0].y;
				}
			}
		}
		else
		{
			if (touchState.event == TE_SLIDE)
			{
				touchState.event = TE_SLIDE_END;
			}
			else if (touchState.event == TE_DOWN)
			{
				touchState.event = TE_UP;
			}
			else if (touchState.event != TE_SLIDE_END) {
				touchState.event = TE_NONE;
			}
		}
	}

	uint8_t zero = 0;
	if (!I2C_GT911_WriteRegister(GT911_READ_XY_REG, &zero, 1))
	{
		TRACE("GT911 ERROR: clearing XY register failed");
	}

	switch (touchState.event) {
		case TE_NONE:
			TRACE("touch event = NONE"); break;
		case TE_UP:
			TRACE("touch event = UP"); break;
		case TE_DOWN:
			TRACE("touch event = DOWN"); break;
		case TE_SLIDE_END:
			TRACE("touch event = SLIDE_END"); break;
		case TE_SLIDE:
			TRACE("touch event = SLIDE"); break;
		default:
			TRACE("touch event = UNKNOWN"); break;
	}
}
/* USER CODE END 0 */

int main(void)
{

  /* MCU Configuration--------------------------------------------------------*/

  /* Reset of all peripherals, Initializes the Flash interface and the Systick. */
  HAL_Init();

  /* Configure the system clock */
  SystemClock_Config();

  /* Initialize all configured peripherals */
  MX_GPIO_Init();
  MX_DMA_Init();
  MX_USB_OTG_FS_PCD_Init();
  MX_FMC_Init();
  MX_USART3_UART_Init();
  MX_LTDC_Init();
  MX_I2C1_Init();
  MX_ADC3_Init();
  MX_DAC_Init();
  MX_SDIO_SD_Init();
  MX_SPI2_Init();
  MX_USART1_UART_Init();
  MX_USART2_UART_Init();
  MX_USART6_UART_Init();
  MX_FATFS_Init();

  /* Init scheduler */
  osKernelInitialize();

  /* Create the semaphores(s) */
  /* creation of BinSemI2CCB */
  BinSemI2CCBHandle = osSemaphoreNew(1, 1, &BinSemI2CCB_attributes);

  /* creation of BinSemTouchINT */
  BinSemTouchINTHandle = osSemaphoreNew(1, 1, &BinSemTouchINT_attributes);

  /* Create the thread(s) */
  /* creation of defaultTask */
  defaultTaskHandle = osThreadNew(StartDefaultTask, NULL, &defaultTask_attributes);

  /* creation of TouchTask */
  TouchTaskHandle = osThreadNew(TouchTaskEntry, NULL, &TouchTask_attributes);

  /* Start scheduler */
  osKernelStart();

  /* We should never get here as control is now taken by the scheduler */
  /* Infinite loop */
  while (1)
  {

    /* USER CODE BEGIN 3 */
    osDelay(pdMS_TO_TICKS(1000));
  }
  /* USER CODE END 3 */
}

void SystemClock_Config(void)
{
  RCC_OscInitTypeDef RCC_OscInitStruct = {0};
  RCC_ClkInitTypeDef RCC_ClkInitStruct = {0};
  RCC_PeriphCLKInitTypeDef PeriphClkInitStruct = {0};

  /** Configure the main internal regulator output voltage
  */
  __HAL_RCC_PWR_CLK_ENABLE();
  __HAL_PWR_VOLTAGESCALING_CONFIG(PWR_REGULATOR_VOLTAGE_SCALE1);
  /** Initializes the RCC Oscillators according to the specified parameters
  * in the RCC_OscInitTypeDef structure.
  */
  RCC_OscInitStruct.OscillatorType = RCC_OSCILLATORTYPE_HSE;
  RCC_OscInitStruct.HSEState = RCC_HSE_ON;
  RCC_OscInitStruct.PLL.PLLState = RCC_PLL_ON;
  RCC_OscInitStruct.PLL.PLLSource = RCC_PLLSOURCE_HSE;
  RCC_OscInitStruct.PLL.PLLM = 6;
  RCC_OscInitStruct.PLL.PLLN = 168;
  RCC_OscInitStruct.PLL.PLLP = RCC_PLLP_DIV2;
  RCC_OscInitStruct.PLL.PLLQ = 7;
  if (HAL_RCC_OscConfig(&RCC_OscInitStruct) != HAL_OK)
  {
    Error_Handler();
  }
  /** Initializes the CPU, AHB and APB buses clocks
  */
  RCC_ClkInitStruct.ClockType = RCC_CLOCKTYPE_HCLK|RCC_CLOCKTYPE_SYSCLK
                              |RCC_CLOCKTYPE_PCLK1|RCC_CLOCKTYPE_PCLK2;
  RCC_ClkInitStruct.SYSCLKSource = RCC_SYSCLKSOURCE_PLLCLK;
  RCC_ClkInitStruct.AHBCLKDivider = RCC_SYSCLK_DIV1;
  RCC_ClkInitStruct.APB1CLKDivider = RCC_HCLK_DIV4;
  RCC_ClkInitStruct.APB2CLKDivider = RCC_HCLK_DIV2;

  if (HAL_RCC_ClockConfig(&RCC_ClkInitStruct, FLASH_LATENCY_5) != HAL_OK)
  {
    Error_Handler();
  }
  PeriphClkInitStruct.PeriphClockSelection = RCC_PERIPHCLK_LTDC;
  PeriphClkInitStruct.PLLSAI.PLLSAIN = 50;
  PeriphClkInitStruct.PLLSAI.PLLSAIR = 2;
  PeriphClkInitStruct.PLLSAIDivR = RCC_PLLSAIDIVR_2;
  if (HAL_RCCEx_PeriphCLKConfig(&PeriphClkInitStruct) != HAL_OK)
  {
    Error_Handler();
  }
}

static void MX_ADC3_Init(void)
{

  ADC_ChannelConfTypeDef sConfig = {0};

  /** Configure the global features of the ADC (Clock, Resolution, Data Alignment and number of conversion)
  */
  hadc3.Instance = ADC3;
  hadc3.Init.ClockPrescaler = ADC_CLOCK_SYNC_PCLK_DIV4;
  hadc3.Init.Resolution = ADC_RESOLUTION_12B;
  hadc3.Init.ScanConvMode = DISABLE;
  hadc3.Init.ContinuousConvMode = DISABLE;
  hadc3.Init.DiscontinuousConvMode = DISABLE;
  hadc3.Init.ExternalTrigConvEdge = ADC_EXTERNALTRIGCONVEDGE_NONE;
  hadc3.Init.ExternalTrigConv = ADC_SOFTWARE_START;
  hadc3.Init.DataAlign = ADC_DATAALIGN_RIGHT;
  hadc3.Init.NbrOfConversion = 1;
  hadc3.Init.DMAContinuousRequests = DISABLE;
  hadc3.Init.EOCSelection = ADC_EOC_SINGLE_CONV;
  if (HAL_ADC_Init(&hadc3) != HAL_OK)
  {
    Error_Handler();
  }
  /** Configure for the selected ADC regular channel its corresponding rank in the sequencer and its sample time.
  */
  sConfig.Channel = ADC_CHANNEL_4;
  sConfig.Rank = 1;
  sConfig.SamplingTime = ADC_SAMPLETIME_3CYCLES;
  if (HAL_ADC_ConfigChannel(&hadc3, &sConfig) != HAL_OK)
  {
    Error_Handler();
  }

}

static void MX_DAC_Init(void)
{

  DAC_ChannelConfTypeDef sConfig = {0};

  /** DAC Initialization
  */
  hdac.Instance = DAC;
  if (HAL_DAC_Init(&hdac) != HAL_OK)
  {
    Error_Handler();
  }
  /** DAC channel OUT1 config
  */
  sConfig.DAC_Trigger = DAC_TRIGGER_NONE;
  sConfig.DAC_OutputBuffer = DAC_OUTPUTBUFFER_ENABLE;
  if (HAL_DAC_ConfigChannel(&hdac, &sConfig, DAC_CHANNEL_1) != HAL_OK)
  {
    Error_Handler();
  }

}

static void MX_I2C1_Init(void)
{

  hi2c1.Instance = I2C1;
  hi2c1.Init.ClockSpeed = 400000;
  hi2c1.Init.DutyCycle = I2C_DUTYCYCLE_16_9;
  hi2c1.Init.OwnAddress1 = 0;
  hi2c1.Init.AddressingMode = I2C_ADDRESSINGMODE_7BIT;
  hi2c1.Init.DualAddressMode = I2C_DUALADDRESS_DISABLE;
  hi2c1.Init.OwnAddress2 = 0;
  hi2c1.Init.GeneralCallMode = I2C_GENERALCALL_DISABLE;
  hi2c1.Init.NoStretchMode = I2C_NOSTRETCH_DISABLE;
  if (HAL_I2C_Init(&hi2c1) != HAL_OK)
  {
    Error_Handler();
  }
  /** Configure Analogue filter
  */
  if (HAL_I2CEx_ConfigAnalogFilter(&hi2c1, I2C_ANALOGFILTER_ENABLE) != HAL_OK)
  {
    Error_Handler();
  }
  /** Configure Digital filter
  */
  if (HAL_I2CEx_ConfigDigitalFilter(&hi2c1, 0) != HAL_OK)
  {
    Error_Handler();
  }

}

static void MX_LTDC_Init(void)
{

  LTDC_LayerCfgTypeDef pLayerCfg = {0};
  LTDC_LayerCfgTypeDef pLayerCfg1 = {0};

  hltdc.Instance = LTDC;
  hltdc.Init.HSPolarity = LTDC_HSPOLARITY_AL;
  hltdc.Init.VSPolarity = LTDC_VSPOLARITY_AL;
  hltdc.Init.DEPolarity = LTDC_DEPOLARITY_AL;
  hltdc.Init.PCPolarity = LTDC_PCPOLARITY_IPC;
  hltdc.Init.HorizontalSync = 2;
  hltdc.Init.VerticalSync = 10;
  hltdc.Init.AccumulatedHBP = 42;
  hltdc.Init.AccumulatedVBP = 12;
  hltdc.Init.AccumulatedActiveW = 522;
  hltdc.Init.AccumulatedActiveH = 284;
  hltdc.Init.TotalWidth = 525;
  hltdc.Init.TotalHeigh = 286;
  hltdc.Init.Backcolor.Blue = 0;
  hltdc.Init.Backcolor.Green = 0;
  hltdc.Init.Backcolor.Red = 0;
  if (HAL_LTDC_Init(&hltdc) != HAL_OK)
  {
    Error_Handler();
  }
  pLayerCfg.WindowX0 = 0;
  pLayerCfg.WindowX1 = 479;
  pLayerCfg.WindowY0 = 0;
  pLayerCfg.WindowY1 = 271;
  pLayerCfg.PixelFormat = LTDC_PIXEL_FORMAT_RGB565;
  pLayerCfg.Alpha = 255;
  pLayerCfg.Alpha0 = 0;
  pLayerCfg.BlendingFactor1 = LTDC_BLENDING_FACTOR1_CA;
  pLayerCfg.BlendingFactor2 = LTDC_BLENDING_FACTOR2_CA;
  pLayerCfg.FBStartAdress = 261120;
  pLayerCfg.ImageWidth = 480;
  pLayerCfg.ImageHeight = 272;
  pLayerCfg.Backcolor.Blue = 0;
  pLayerCfg.Backcolor.Green = 0;
  pLayerCfg.Backcolor.Red = 0;
  if (HAL_LTDC_ConfigLayer(&hltdc, &pLayerCfg, 0) != HAL_OK)
  {
    Error_Handler();
  }
  pLayerCfg1.WindowX0 = 0;
  pLayerCfg1.WindowX1 = 479;
  pLayerCfg1.WindowY0 = 0;
  pLayerCfg1.WindowY1 = 271;
  pLayerCfg1.PixelFormat = LTDC_PIXEL_FORMAT_RGB565;
  pLayerCfg1.Alpha = 255;
  pLayerCfg1.Alpha0 = 0;
  pLayerCfg1.BlendingFactor1 = LTDC_BLENDING_FACTOR1_CA;
  pLayerCfg1.BlendingFactor2 = LTDC_BLENDING_FACTOR2_CA;
  pLayerCfg1.FBStartAdress = 261120;
  pLayerCfg1.ImageWidth = 480;
  pLayerCfg1.ImageHeight = 272;
  pLayerCfg1.Backcolor.Blue = 0;
  pLayerCfg1.Backcolor.Green = 0;
  pLayerCfg1.Backcolor.Red = 0;
  if (HAL_LTDC_ConfigLayer(&hltdc, &pLayerCfg1, 1) != HAL_OK)
  {
    Error_Handler();
  }

}

static void MX_SDIO_SD_Init(void)
{

  hsd.Instance = SDIO;
  hsd.Init.ClockEdge = SDIO_CLOCK_EDGE_RISING;
  hsd.Init.ClockBypass = SDIO_CLOCK_BYPASS_DISABLE;
  hsd.Init.ClockPowerSave = SDIO_CLOCK_POWER_SAVE_DISABLE;
  hsd.Init.BusWide = SDIO_BUS_WIDE_1B;
  hsd.Init.HardwareFlowControl = SDIO_HARDWARE_FLOW_CONTROL_DISABLE;
  hsd.Init.ClockDiv = 0;

}

static void MX_SPI2_Init(void)
{

  /* SPI2 parameter configuration*/
  hspi2.Instance = SPI2;
  hspi2.Init.Mode = SPI_MODE_MASTER;
  hspi2.Init.Direction = SPI_DIRECTION_2LINES;
  hspi2.Init.DataSize = SPI_DATASIZE_8BIT;
  hspi2.Init.CLKPolarity = SPI_POLARITY_LOW;
  hspi2.Init.CLKPhase = SPI_PHASE_1EDGE;
  hspi2.Init.NSS = SPI_NSS_HARD_OUTPUT;
  hspi2.Init.BaudRatePrescaler = SPI_BAUDRATEPRESCALER_2;
  hspi2.Init.FirstBit = SPI_FIRSTBIT_MSB;
  hspi2.Init.TIMode = SPI_TIMODE_DISABLE;
  hspi2.Init.CRCCalculation = SPI_CRCCALCULATION_DISABLE;
  hspi2.Init.CRCPolynomial = 10;
  if (HAL_SPI_Init(&hspi2) != HAL_OK)
  {
    Error_Handler();
  }

}

static void MX_USART1_UART_Init(void)
{

  huart1.Instance = USART1;
  huart1.Init.BaudRate = 115200;
  huart1.Init.WordLength = UART_WORDLENGTH_8B;
  huart1.Init.StopBits = UART_STOPBITS_1;
  huart1.Init.Parity = UART_PARITY_NONE;
  huart1.Init.Mode = UART_MODE_TX_RX;
  huart1.Init.HwFlowCtl = UART_HWCONTROL_NONE;
  huart1.Init.OverSampling = UART_OVERSAMPLING_16;
  if (HAL_UART_Init(&huart1) != HAL_OK)
  {
    Error_Handler();
  }

}

static void MX_USART2_UART_Init(void)
{

  huart2.Instance = USART2;
  huart2.Init.BaudRate = 115200;
  huart2.Init.WordLength = UART_WORDLENGTH_8B;
  huart2.Init.StopBits = UART_STOPBITS_1;
  huart2.Init.Parity = UART_PARITY_NONE;
  huart2.Init.Mode = UART_MODE_TX_RX;
  huart2.Init.HwFlowCtl = UART_HWCONTROL_NONE;
  huart2.Init.OverSampling = UART_OVERSAMPLING_16;
  if (HAL_UART_Init(&huart2) != HAL_OK)
  {
    Error_Handler();
  }

}

static void MX_USART3_UART_Init(void)
{

  huart3.Instance = USART3;
  huart3.Init.BaudRate = 400000;
  huart3.Init.WordLength = UART_WORDLENGTH_8B;
  huart3.Init.StopBits = UART_STOPBITS_1;
  huart3.Init.Parity = UART_PARITY_NONE;
  huart3.Init.Mode = UART_MODE_TX_RX;
  huart3.Init.HwFlowCtl = UART_HWCONTROL_NONE;
  huart3.Init.OverSampling = UART_OVERSAMPLING_16;
  if (HAL_UART_Init(&huart3) != HAL_OK)
  {
    Error_Handler();
  }

}

static void MX_USART6_UART_Init(void)
{

  huart6.Instance = USART6;
  huart6.Init.BaudRate = 115200;
  huart6.Init.WordLength = UART_WORDLENGTH_8B;
  huart6.Init.StopBits = UART_STOPBITS_1;
  huart6.Init.Parity = UART_PARITY_NONE;
  huart6.Init.Mode = UART_MODE_TX_RX;
  huart6.Init.HwFlowCtl = UART_HWCONTROL_NONE;
  huart6.Init.OverSampling = UART_OVERSAMPLING_16;
  if (HAL_UART_Init(&huart6) != HAL_OK)
  {
    Error_Handler();
  }

}

static void MX_USB_OTG_FS_PCD_Init(void)
{

  hpcd_USB_OTG_FS.Instance = USB_OTG_FS;
  hpcd_USB_OTG_FS.Init.dev_endpoints = 4;
  hpcd_USB_OTG_FS.Init.speed = PCD_SPEED_FULL;
  hpcd_USB_OTG_FS.Init.dma_enable = DISABLE;
  hpcd_USB_OTG_FS.Init.phy_itface = PCD_PHY_EMBEDDED;
  hpcd_USB_OTG_FS.Init.Sof_enable = DISABLE;
  hpcd_USB_OTG_FS.Init.low_power_enable = DISABLE;
  hpcd_USB_OTG_FS.Init.lpm_enable = DISABLE;
  hpcd_USB_OTG_FS.Init.vbus_sensing_enable = ENABLE;
  hpcd_USB_OTG_FS.Init.use_dedicated_ep1 = DISABLE;
  if (HAL_PCD_Init(&hpcd_USB_OTG_FS) != HAL_OK)
  {
    Error_Handler();
  }

}

static void MX_DMA_Init(void)
{

  /* DMA controller clock enable */
  __HAL_RCC_DMA1_CLK_ENABLE();

  /* DMA interrupt init */
  /* DMA1_Stream0_IRQn interrupt configuration */
  HAL_NVIC_SetPriority(DMA1_Stream0_IRQn, 5, 0);
  HAL_NVIC_EnableIRQ(DMA1_Stream0_IRQn);
  /* DMA1_Stream6_IRQn interrupt configuration */
  HAL_NVIC_SetPriority(DMA1_Stream6_IRQn, 5, 0);
  HAL_NVIC_EnableIRQ(DMA1_Stream6_IRQn);

}

/* FMC initialization function */
static void MX_FMC_Init(void)
{

  FMC_SDRAM_TimingTypeDef SdramTiming = {0};

  /** Perform the SDRAM1 memory initialization sequence
  */
  hsdram1.Instance = FMC_SDRAM_DEVICE;
  /* hsdram1.Init */
  hsdram1.Init.SDBank = FMC_SDRAM_BANK2;
  hsdram1.Init.ColumnBitsNumber = FMC_SDRAM_COLUMN_BITS_NUM_8;
  hsdram1.Init.RowBitsNumber = FMC_SDRAM_ROW_BITS_NUM_12;
  hsdram1.Init.MemoryDataWidth = FMC_SDRAM_MEM_BUS_WIDTH_16;
  hsdram1.Init.InternalBankNumber = FMC_SDRAM_INTERN_BANKS_NUM_4;
  hsdram1.Init.CASLatency = FMC_SDRAM_CAS_LATENCY_1;
  hsdram1.Init.WriteProtection = FMC_SDRAM_WRITE_PROTECTION_DISABLE;
  hsdram1.Init.SDClockPeriod = FMC_SDRAM_CLOCK_DISABLE;
  hsdram1.Init.ReadBurst = FMC_SDRAM_RBURST_DISABLE;
  hsdram1.Init.ReadPipeDelay = FMC_SDRAM_RPIPE_DELAY_0;
  /* SdramTiming */
  SdramTiming.LoadToActiveDelay = 16;
  SdramTiming.ExitSelfRefreshDelay = 16;
  SdramTiming.SelfRefreshTime = 16;
  SdramTiming.RowCycleDelay = 16;
  SdramTiming.WriteRecoveryTime = 16;
  SdramTiming.RPDelay = 16;
  SdramTiming.RCDDelay = 16;

  if (HAL_SDRAM_Init(&hsdram1, &SdramTiming) != HAL_OK)
  {
    Error_Handler( );
  }

}

static void MX_GPIO_Init(void)
{
  GPIO_InitTypeDef GPIO_InitStruct = {0};

  /* GPIO Ports Clock Enable */
  __HAL_RCC_GPIOE_CLK_ENABLE();
  __HAL_RCC_GPIOI_CLK_ENABLE();
  __HAL_RCC_GPIOC_CLK_ENABLE();
  __HAL_RCC_GPIOF_CLK_ENABLE();
  __HAL_RCC_GPIOH_CLK_ENABLE();
  __HAL_RCC_GPIOA_CLK_ENABLE();
  __HAL_RCC_GPIOB_CLK_ENABLE();
  __HAL_RCC_GPIOJ_CLK_ENABLE();
  __HAL_RCC_GPIOG_CLK_ENABLE();
  __HAL_RCC_GPIOD_CLK_ENABLE();
  __HAL_RCC_GPIOK_CLK_ENABLE();

  /*Configure GPIO pin Output Level */
  HAL_GPIO_WritePin(GPIOE, LEDred_Pin|LEDgreen_Pin|LEDblue_Pin|HAPTIC_Pin, GPIO_PIN_RESET);

  /*Configure GPIO pin Output Level */
  HAL_GPIO_WritePin(INTMODboot_GPIO_Port, INTMODboot_Pin, GPIO_PIN_RESET);

  /*Configure GPIO pin Output Level */
  HAL_GPIO_WritePin(LCDnRST_GPIO_Port, LCDnRST_Pin, GPIO_PIN_SET);

  /*Configure GPIO pin Output Level */
  HAL_GPIO_WritePin(TOUCH_RST_GPIO_Port, TOUCH_RST_Pin, GPIO_PIN_RESET);

  /*Configure GPIO pin Output Level */
  HAL_GPIO_WritePin(GPIOA, TESTPOINT_Pin|IntModPwr_Pin|UART3Pwr_Pin, GPIO_PIN_RESET);

  /*Configure GPIO pin Output Level */
  HAL_GPIO_WritePin(AudioMute_GPIO_Port, AudioMute_Pin, GPIO_PIN_SET);

  /*Configure GPIO pin Output Level */
  HAL_GPIO_WritePin(GPIOB, UART6pwr_Pin|LCDbacklight_Pin|ExtModPwr_Pin, GPIO_PIN_RESET);

  /*Configure GPIO pin Output Level */
  HAL_GPIO_WritePin(PWRon_GPIO_Port, PWRon_Pin, GPIO_PIN_SET);

  /*Configure GPIO pin Output Level */
  HAL_GPIO_WritePin(TrainerOut_GPIO_Port, TrainerOut_Pin, GPIO_PIN_RESET);

  /*Configure GPIO pin Output Level */
  HAL_GPIO_WritePin(TelemDir_GPIO_Port, TelemDir_Pin, GPIO_PIN_RESET);

  /*Configure GPIO pin Output Level */
  HAL_GPIO_WritePin(BluetoothEn_GPIO_Port, BluetoothEn_Pin, GPIO_PIN_RESET);

  /*Configure GPIO pins : LEDred_Pin LEDgreen_Pin LEDblue_Pin HAPTIC_Pin */
  GPIO_InitStruct.Pin = LEDred_Pin|LEDgreen_Pin|LEDblue_Pin|HAPTIC_Pin;
  GPIO_InitStruct.Mode = GPIO_MODE_OUTPUT_PP;
  GPIO_InitStruct.Pull = GPIO_NOPULL;
  GPIO_InitStruct.Speed = GPIO_SPEED_FREQ_LOW;
  HAL_GPIO_Init(GPIOE, &GPIO_InitStruct);

  /*Configure GPIO pin : SWEL_Pin */
  GPIO_InitStruct.Pin = SWEL_Pin;
  GPIO_InitStruct.Mode = GPIO_MODE_INPUT;
  GPIO_InitStruct.Pull = GPIO_NOPULL;
  HAL_GPIO_Init(SWEL_GPIO_Port, &GPIO_InitStruct);

  /*Configure GPIO pins : KEYenter_Pin KEYpageprevious_Pin SWAL_Pin KEYrtn_Pin
                           KEYtelem_Pin KEYmdl_Pin KEYsys_Pin */
  GPIO_InitStruct.Pin = KEYenter_Pin|KEYpageprevious_Pin|SWAL_Pin|KEYrtn_Pin
                          |KEYtelem_Pin|KEYmdl_Pin|KEYsys_Pin;
  GPIO_InitStruct.Mode = GPIO_MODE_INPUT;
  GPIO_InitStruct.Pull = GPIO_PULLUP;
  HAL_GPIO_Init(GPIOI, &GPIO_InitStruct);

  /*Configure GPIO pins : KEYpagenext_Pin TrimLHR_Pin */
  GPIO_InitStruct.Pin = KEYpagenext_Pin|TrimLHR_Pin;
  GPIO_InitStruct.Mode = GPIO_MODE_INPUT;
  GPIO_InitStruct.Pull = GPIO_PULLUP;
  HAL_GPIO_Init(GPIOC, &GPIO_InitStruct);

  /*Configure GPIO pins : INTMODboot_Pin LCDnRST_Pin */
  GPIO_InitStruct.Pin = INTMODboot_Pin|LCDnRST_Pin;
  GPIO_InitStruct.Mode = GPIO_MODE_OUTPUT_PP;
  GPIO_InitStruct.Pull = GPIO_NOPULL;
  GPIO_InitStruct.Speed = GPIO_SPEED_FREQ_LOW;
  HAL_GPIO_Init(GPIOI, &GPIO_InitStruct);

  /*Configure GPIO pin : TOUCH_RST_Pin */
  GPIO_InitStruct.Pin = TOUCH_RST_Pin;
  GPIO_InitStruct.Mode = GPIO_MODE_OUTPUT_PP;
  GPIO_InitStruct.Pull = GPIO_NOPULL;
  GPIO_InitStruct.Speed = GPIO_SPEED_FREQ_LOW;
  HAL_GPIO_Init(TOUCH_RST_GPIO_Port, &GPIO_InitStruct);

  /*Configure GPIO pin : TOUCH_INT_Pin */
  GPIO_InitStruct.Pin = TOUCH_INT_Pin;
  GPIO_InitStruct.Mode = GPIO_MODE_IT_RISING;
  GPIO_InitStruct.Pull = GPIO_NOPULL;
  HAL_GPIO_Init(TOUCH_INT_GPIO_Port, &GPIO_InitStruct);

  /*Configure GPIO pins : SWF_Pin SWEH_Pin SWAH_Pin SWBH_Pin
                           SWI_Pin SWJ_Pin */
  GPIO_InitStruct.Pin = SWF_Pin|SWEH_Pin|SWAH_Pin|SWBH_Pin
                          |SWI_Pin|SWJ_Pin;
  GPIO_InitStruct.Mode = GPIO_MODE_INPUT;
  GPIO_InitStruct.Pull = GPIO_PULLUP;
  HAL_GPIO_Init(GPIOH, &GPIO_InitStruct);

  /*Configure GPIO pins : TESTPOINT_Pin AudioMute_Pin IntModPwr_Pin UART3Pwr_Pin */
  GPIO_InitStruct.Pin = TESTPOINT_Pin|AudioMute_Pin|IntModPwr_Pin|UART3Pwr_Pin;
  GPIO_InitStruct.Mode = GPIO_MODE_OUTPUT_PP;
  GPIO_InitStruct.Pull = GPIO_NOPULL;
  GPIO_InitStruct.Speed = GPIO_SPEED_FREQ_LOW;
  HAL_GPIO_Init(GPIOA, &GPIO_InitStruct);

  /*Configure GPIO pin : TrimLHL_Pin */
  GPIO_InitStruct.Pin = TrimLHL_Pin;
  GPIO_InitStruct.Mode = GPIO_MODE_INPUT;
  GPIO_InitStruct.Pull = GPIO_PULLUP;
  HAL_GPIO_Init(TrimLHL_GPIO_Port, &GPIO_InitStruct);

  /*Configure GPIO pins : SDpresent_Pin TrainerIn_Pin */
  GPIO_InitStruct.Pin = SDpresent_Pin|TrainerIn_Pin;
  GPIO_InitStruct.Mode = GPIO_MODE_INPUT;
  GPIO_InitStruct.Pull = GPIO_NOPULL;
  HAL_GPIO_Init(GPIOC, &GPIO_InitStruct);

  /*Configure GPIO pins : UART6pwr_Pin LCDbacklight_Pin ExtModPwr_Pin */
  GPIO_InitStruct.Pin = UART6pwr_Pin|LCDbacklight_Pin|ExtModPwr_Pin;
  GPIO_InitStruct.Mode = GPIO_MODE_OUTPUT_PP;
  GPIO_InitStruct.Pull = GPIO_NOPULL;
  GPIO_InitStruct.Speed = GPIO_SPEED_FREQ_LOW;
  HAL_GPIO_Init(GPIOB, &GPIO_InitStruct);

  /*Configure GPIO pin : PWRswitch_Pin */
  GPIO_InitStruct.Pin = PWRswitch_Pin;
  GPIO_InitStruct.Mode = GPIO_MODE_INPUT;
  GPIO_InitStruct.Pull = GPIO_NOPULL;
  HAL_GPIO_Init(PWRswitch_GPIO_Port, &GPIO_InitStruct);

  /*Configure GPIO pin : PWRon_Pin */
  GPIO_InitStruct.Pin = PWRon_Pin;
  GPIO_InitStruct.Mode = GPIO_MODE_OUTPUT_PP;
  GPIO_InitStruct.Pull = GPIO_NOPULL;
  GPIO_InitStruct.Speed = GPIO_SPEED_FREQ_LOW;
  HAL_GPIO_Init(PWRon_GPIO_Port, &GPIO_InitStruct);

  /*Configure GPIO pins : PCBREV1_Pin PCBREV2_Pin ROTENCB_Pin ROTENCA_Pin */
  GPIO_InitStruct.Pin = PCBREV1_Pin|PCBREV2_Pin|ROTENCB_Pin|ROTENCA_Pin;
  GPIO_InitStruct.Mode = GPIO_MODE_INPUT;
  GPIO_InitStruct.Pull = GPIO_NOPULL;
  HAL_GPIO_Init(GPIOH, &GPIO_InitStruct);

  /*Configure GPIO pins : SWBL_Pin TrainerDetect_Pin */
  GPIO_InitStruct.Pin = SWBL_Pin|TrainerDetect_Pin;
  GPIO_InitStruct.Mode = GPIO_MODE_INPUT;
  GPIO_InitStruct.Pull = GPIO_NOPULL;
  HAL_GPIO_Init(GPIOB, &GPIO_InitStruct);

  /*Configure GPIO pins : TrimRSD_Pin TrimRSU_Pin SWCL_Pin */
  GPIO_InitStruct.Pin = TrimRSD_Pin|TrimRSU_Pin|SWCL_Pin;
  GPIO_InitStruct.Mode = GPIO_MODE_INPUT;
  GPIO_InitStruct.Pull = GPIO_PULLUP;
  HAL_GPIO_Init(GPIOB, &GPIO_InitStruct);

  /*Configure GPIO pins : SWCH_Pin TrimLSU_Pin TrimR_Pin TrimRHR_Pin */
  GPIO_InitStruct.Pin = SWCH_Pin|TrimLSU_Pin|TrimR_Pin|TrimRHR_Pin;
  GPIO_InitStruct.Mode = GPIO_MODE_INPUT;
  GPIO_InitStruct.Pull = GPIO_PULLUP;
  HAL_GPIO_Init(GPIOD, &GPIO_InitStruct);

  /*Configure GPIO pin : HEARTBEAT_Pin */
  GPIO_InitStruct.Pin = HEARTBEAT_Pin;
  GPIO_InitStruct.Mode = GPIO_MODE_INPUT;
  GPIO_InitStruct.Pull = GPIO_NOPULL;
  HAL_GPIO_Init(HEARTBEAT_GPIO_Port, &GPIO_InitStruct);

  /*Configure GPIO pins : SWDH_Pin TrimLSD_Pin TrimRV_Pin TrimRVD_Pin
                           TrimLVU_Pin */
  GPIO_InitStruct.Pin = SWDH_Pin|TrimLSD_Pin|TrimRV_Pin|TrimRVD_Pin
                          |TrimLVU_Pin;
  GPIO_InitStruct.Mode = GPIO_MODE_INPUT;
  GPIO_InitStruct.Pull = GPIO_PULLUP;
  HAL_GPIO_Init(GPIOJ, &GPIO_InitStruct);

  /*Configure GPIO pins : SWDL_Pin SWGL_Pin SWGH_Pin SWH_Pin
                           TrimLVD_Pin */
  GPIO_InitStruct.Pin = SWDL_Pin|SWGL_Pin|SWGH_Pin|SWH_Pin
                          |TrimLVD_Pin;
  GPIO_InitStruct.Mode = GPIO_MODE_INPUT;
  GPIO_InitStruct.Pull = GPIO_PULLUP;
  HAL_GPIO_Init(GPIOG, &GPIO_InitStruct);

  /*Configure GPIO pin : TrainerOut_Pin */
  GPIO_InitStruct.Pin = TrainerOut_Pin;
  GPIO_InitStruct.Mode = GPIO_MODE_OUTPUT_PP;
  GPIO_InitStruct.Pull = GPIO_NOPULL;
  GPIO_InitStruct.Speed = GPIO_SPEED_FREQ_LOW;
  HAL_GPIO_Init(TrainerOut_GPIO_Port, &GPIO_InitStruct);

  /*Configure GPIO pin : ExtModTX_Pin */
  GPIO_InitStruct.Pin = ExtModTX_Pin;
  GPIO_InitStruct.Mode = GPIO_MODE_INPUT;
  GPIO_InitStruct.Pull = GPIO_NOPULL;
  HAL_GPIO_Init(ExtModTX_GPIO_Port, &GPIO_InitStruct);

  /*Configure GPIO pin : TelemDir_Pin */
  GPIO_InitStruct.Pin = TelemDir_Pin;
  GPIO_InitStruct.Mode = GPIO_MODE_OUTPUT_PP;
  GPIO_InitStruct.Pull = GPIO_NOPULL;
  GPIO_InitStruct.Speed = GPIO_SPEED_FREQ_LOW;
  HAL_GPIO_Init(TelemDir_GPIO_Port, &GPIO_InitStruct);

  /*Configure GPIO pin : BluetoothEn_Pin */
  GPIO_InitStruct.Pin = BluetoothEn_Pin;
  GPIO_InitStruct.Mode = GPIO_MODE_OUTPUT_PP;
  GPIO_InitStruct.Pull = GPIO_NOPULL;
  GPIO_InitStruct.Speed = GPIO_SPEED_FREQ_LOW;
  HAL_GPIO_Init(BluetoothEn_GPIO_Port, &GPIO_InitStruct);

  /*Configure GPIO pins : USBchaCtrl_Pin USBchgDetect_Pin */
  GPIO_InitStruct.Pin = USBchaCtrl_Pin|USBchgDetect_Pin;
  GPIO_InitStruct.Mode = GPIO_MODE_INPUT;
  GPIO_InitStruct.Pull = GPIO_NOPULL;
  HAL_GPIO_Init(GPIOG, &GPIO_InitStruct);

  /* EXTI interrupt init*/
  HAL_NVIC_SetPriority(EXTI2_IRQn, 5, 0);
  HAL_NVIC_EnableIRQ(EXTI2_IRQn);

}

/* USER CODE BEGIN 4 */

void HAL_I2C_MemTxCpltCallback(I2C_HandleTypeDef *hi2c)
{
	BaseType_t xHigherPriorityTaskWoken = false;
	if (BinSemI2CCBHandle)
		xSemaphoreGiveFromISR(BinSemI2CCBHandle, &xHigherPriorityTaskWoken);
	portYIELD_FROM_ISR(xHigherPriorityTaskWoken);
}

void HAL_I2C_MemRxCpltCallback(I2C_HandleTypeDef *hi2c)
{
	BaseType_t xHigherPriorityTaskWoken = false;
	if (BinSemI2CCBHandle)
		xSemaphoreGiveFromISR(BinSemI2CCBHandle, &xHigherPriorityTaskWoken);
	portYIELD_FROM_ISR(xHigherPriorityTaskWoken);
}

void HAL_GPIO_EXTI_Callback(uint16_t GPIO_Pin)
{
	if (GPIO_Pin == GPIO_PIN_2)
	{
		BaseType_t xHigherPriorityTaskWoken = false;
		if (BinSemTouchINTHandle)
			xSemaphoreGiveFromISR(BinSemTouchINTHandle, &xHigherPriorityTaskWoken);
	  	portYIELD_FROM_ISR(xHigherPriorityTaskWoken);
	}
}
/* USER CODE END 4 */

void StartDefaultTask(void *argument)
{
  /* USER CODE BEGIN 5 */
  HAL_GPIO_WritePin(PWRon_GPIO_Port, PWRon_Pin, GPIO_PIN_SET); // Turn on power
  HAL_GPIO_WritePin(LEDred_GPIO_Port, LEDred_Pin, GPIO_PIN_RESET);
  HAL_GPIO_WritePin(LEDgreen_GPIO_Port, LEDgreen_Pin, GPIO_PIN_SET);
  HAL_GPIO_WritePin(LEDblue_GPIO_Port, LEDblue_Pin, GPIO_PIN_RESET);

  /* Infinite loop */
  for(;;)
  {
   	// Check Power-Off
   	if (HAL_GPIO_ReadPin(PWRswitch_GPIO_Port, PWRswitch_Pin) == GPIO_PIN_RESET)
   	{
   		//HAL_GPIO_WritePin(LEDred_GPIO_Port, LEDred_Pin, GPIO_PIN_SET);
   		//HAL_GPIO_WritePin(LEDgreen_GPIO_Port, LEDgreen_Pin, GPIO_PIN_RESET);
   		HAL_GPIO_WritePin(LEDblue_GPIO_Port, LEDblue_Pin, GPIO_PIN_SET);

   	    TRACE("defaultTask Stack: %lu", uxTaskGetStackHighWaterMark(defaultTaskHandle));
   	    TRACE("TouchTask Stack: %lu", uxTaskGetStackHighWaterMark(TouchTaskHandle));

   		// Check again in 1 second
   		osDelay(pdMS_TO_TICKS(1000));
   		if (HAL_GPIO_ReadPin(PWRswitch_GPIO_Port, PWRswitch_Pin) == GPIO_PIN_RESET)
   		{
   			HAL_GPIO_WritePin(PWRon_GPIO_Port, PWRon_Pin, GPIO_PIN_RESET); // Turn off power
   		}
   	}
   	HAL_GPIO_WritePin(LEDblue_GPIO_Port, LEDblue_Pin, GPIO_PIN_RESET);

   	osDelay(pdMS_TO_TICKS(100));
  }
  /* USER CODE END 5 */
}

void TouchTaskEntry(void *argument)
{
  /* USER CODE BEGIN TouchTaskEntry */
  osDelay(pdMS_TO_TICKS (50));

  xSemaphoreTake(BinSemI2CCBHandle, 0);

  if (!touchPanelInit())
  {
    TRACE("ERROR: touchPanelInit() failed");
    asm("bkpt 255");
  }

  xSemaphoreTake(BinSemTouchINTHandle, 0);
  /* EXTI interrupt init*/
  HAL_NVIC_SetPriority(EXTI2_IRQn, 5, 0);
  HAL_NVIC_EnableIRQ(EXTI2_IRQn);

  /* Infinite loop */
  for(;;)
  {
	xSemaphoreTake(BinSemTouchINTHandle, portMAX_DELAY);
	touchPanelRead();

	/*
	if (touchEventOccured)
	{
		touchEventOccured = false;
		touchPanelRead();
	}*/

	/*
    if (HAL_GPIO_ReadPin(TOUCH_INT_GPIO_Port, TOUCH_INT_Pin) == GPIO_PIN_SET)
   	{
    	touchPanelRead();
   	} */

  }
  /* USER CODE END TouchTaskEntry */
}

 /**
  * @brief  Period elapsed callback in non blocking mode
  * @note   This function is called  when TIM1 interrupt took place, inside
  * HAL_TIM_IRQHandler(). It makes a direct call to HAL_IncTick() to increment
  * a global variable "uwTick" used as application time base.
  * @param  htim : TIM handle
  * @retval None
  */
void HAL_TIM_PeriodElapsedCallback(TIM_HandleTypeDef *htim)
{
  if (htim->Instance == TIM1) {
    HAL_IncTick();
  }
}

void Error_Handler(void)
{
  __disable_irq();
  while (1)
  {
  }
}

/************************ (C) COPYRIGHT STMicroelectronics *****END OF FILE****/
